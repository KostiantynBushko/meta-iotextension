## conf/layer.conf
```bitbake
# We have a conf and classes directory, add to BBPATH
BBPATH .= ":${LAYERDIR}"

# We have recipes-* directories, add to BBFILES
BBFILES += "${LAYERDIR}/recipes-*/*/*.bb \
            ${LAYERDIR}/recipes-*/*/*.bbappend"

BBFILE_COLLECTIONS += "meta-iotextension"
BBFILE_PATTERN_meta-iotextension = "^${LAYERDIR}/"
BBFILE_PRIORITY_meta-iotextension = "8"

LAYERDEPENDS_meta-iotextension = "core"
LAYERSERIES_COMPAT_meta-iotextension = "warrior"
```
